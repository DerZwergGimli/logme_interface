## main/Kconfig.projbuild
```kconfig
menu "Example Configuration"

    config EXAMPLE_MDNS_HOST_NAME
        string "mDNS Host Name"
        default "esp-home"
        help
            Specify the domain name used in the mDNS service.
            Note that webpage also take it as a part of URL where it will send GET/POST requests to.
    
    config SMART_METER_SENSOR_LENGTH
        int "Connected SmartMeter"
        default 4
        help
            Specify the domain name used in the mDNS service.
            Note that webpage also take it as a part of URL where it will send GET/POST requests to.

    choice EXAMPLE_WEB_DEPLOY_MODE
        prompt "Website deploy mode"
        default EXAMPLE_WEB_DEPLOY_SEMIHOST
        help
            Select website deploy mode.
            You can deploy website to host, and ESP32 will retrieve them in a semihost way (JTAG is needed).
            You can deploy website to SD card or SPI flash, and ESP32 will retrieve them via SDIO/SPI interface.
            Detailed operation steps are listed in the example README file.
        config EXAMPLE_WEB_DEPLOY_SEMIHOST
            bool "Deploy website to host (JTAG is needed)"
            help
                Deploy website to host.
                It is recommended to choose this mode during developing.
        config EXAMPLE_WEB_DEPLOY_SD
            depends on IDF_TARGET_ESP32
            bool "Deploy website to SD card"
            help
                Deploy website to SD card.
                Choose this production mode if the size of website is too large (bigger than 2MB).
        config EXAMPLE_WEB_DEPLOY_SF
            bool "Deploy website to SPI Nor Flash"
            help
                Deploy website to SPI Nor Flash.
                Choose this production mode if the size of website is small (less than 2MB).
    endchoice

    if EXAMPLE_WEB_DEPLOY_SEMIHOST
        config EXAMPLE_HOST_PATH_TO_MOUNT
            string "Host path to mount (e.g. absolute path to web dist directory)"
            default "PATH-TO-WEB-DIST_DIR"
            help
                When using semihost in ESP32, you should specify the host path which will be mounted to VFS.
                Note that only absolute path is acceptable.
    endif

    config EXAMPLE_WEB_MOUNT_POINT
        string "Website mount point in VFS"
        default "/www"
        help
            Specify the mount point in VFS.

endmenu

menu "LogME"
    config LOGME_VERSION
        string "Set APP Version"
        default "0.0.0"
        help
            Sets the APP_Version for LogME

endmenu

menu "Wifi Manager Configuration"

    config WIFI_MANAGER_TASK_PRIORITY
        int "RTOS Task Priority for the wifi_manager"
        default 5
        help
        Tasks spawn by the manager will have a priority of WIFI_MANAGER_TASK_PRIORITY-1. For this particular reason, minimum recommended task priority is 2.
    
    config WIFI_MANAGER_RETRY_TIMER
        int "Time (in ms) between each retry attempt"
        default 5000
        help
        Defines the time to wait before an attempt to re-connect to a saved wifi is made after connection is lost or another unsuccesful attempt is made.
    
    config WIFI_MANAGER_MAX_RETRY_START_AP
        int "Max Retry before starting the AP"
        default 3
        help
        Defines the maximum number of failed retries allowed before the WiFi manager starts its own access point.  
        
    config WIFI_MANAGER_SHUTDOWN_AP_TIMER
        int "Time (in ms) to wait before shutting down the AP"
        default 60000
        help
        Defines the time (in ms) to wait after a succesful connection before shutting down the access point.
    
    config WEBAPP_LOCATION
        string "Defines the URL where the wifi manager is located"
        default "/"
        help
        This parameter helps you relocate the wifimanager to another URL, for instance /wifimanager/ The trailing slash is important and should be included
    
    config DEFAULT_AP_SSID
        string "Access Point SSID"
        default "esp32"
        help
        SSID (network name) the the esp32 will broadcast.
    
    config DEFAULT_AP_PASSWORD
        string "Access Point Password"
        default "esp32pwd"
        help
        Password used for the Access Point. Leave empty and set AUTH MODE to WIFI_AUTH_OPEN for no password.
    
    config DEFAULT_AP_CHANNEL
        int "Access Point WiFi Channel"
        default 1
        help
        Be careful you might not see the access point if you use a channel not allowed in your country.
    
    config DEFAULT_AP_IP
        string "Access Point IP Address"
        default "10.10.0.1"
        help
        This is used for the redirection to the captive portal. It is recommended to leave unchanged.
    
    config DEFAULT_AP_GATEWAY
        string "Access Point IP Gateway"
        default "10.10.0.1"
        help
        This is used for the redirection to the captive portal. It is recommended to leave unchanged.
    
    config DEFAULT_AP_NETMASK
        string "Access Point Netmask"
        default "255.255.255.0"
        help
        This is used for the redirection to the captive portal. It is recommended to leave unchanged.
    
    config DEFAULT_AP_MAX_CONNECTIONS
        int "Access Point Max Connections"
        default 4
        help
        Max is 4.
    
    config DEFAULT_AP_BEACON_INTERVAL
        int "Access Point Beacon Interval (ms)"
        default 100
        help
        100ms is the recommended default.

    endmenu
    
```
